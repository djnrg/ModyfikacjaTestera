// Program odczytuje temperaturę kilku czujników

#include <OneWire.h>
#include <DS18B20.h>

// Numer pinu do którego podłaczasz czujnik
#define ONEWIRE_PIN 7

// Ilość czujników
#define SENSORS_NUM 8

// Adresy czujników
const byte address[SENSORS_NUM][8] PROGMEM = {
0x28, 0x67, 0x72, 0xE0, 0x5, 0x0, 0x0, 0xCA,
0x28, 0x4F, 0xEA, 0xDF, 0x5, 0x0, 0x0, 0x86,
0x28, 0x51, 0xA5, 0xE0, 0x5, 0x0, 0x0, 0x9A,
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0x28, 0xBC, 0xAA, 0xE0, 0x5, 0x0, 0x0, 0x96
};
float temperature;
OneWire onewire(ONEWIRE_PIN);
DS18B20 sensors(&onewire);

void setup() {
  while(!Serial);
  Serial.begin(9600);

  sensors.begin();
  sensors.request();
}

void loop() {
  if (sensors.available())
  {
    for (byte i=0; i<SENSORS_NUM; i++)
    {
     temperature = sensors.readTemperature(FA(address[i]));

Serial.print(temperature);
Serial.print("; ");

     
//      Serial.println(F(" 'C"));
    }

    sensors.request();
  }
  

Serial.println();
delay(800);
  // tu umieść resztę twojego programu
  // Będzie działał bez blokowania
}
